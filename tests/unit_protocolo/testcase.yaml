## tests/unit_protocolo/testcase.yaml
```yaml
tests:
  uart_led.protocolo:
    tags:
      - uart
      - protocolo
    platform_allow:
      - frdm_kl25z
      - native_sim
    integration_platforms:
      - native_sim
```
